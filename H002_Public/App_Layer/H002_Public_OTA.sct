;******************************************************************************
;
; H001Public.sct
;
; Scatter file for Keil linker configuration.
;
;******************************************************************************

;******************************************************************************
;
; Copyright (c) 2018, Ambiq Micro
; All rights reserved.
; 
; Redistribution and use in source and binary forms, with or without
; modification, are permitted provided that the following conditions are met:
; 
; 1. Redistributions of source code must retain the above copyright notice,
; this list of conditions and the following disclaimer.
; 
; 2. Redistributions in binary form must reproduce the above copyright
; notice, this list of conditions and the following disclaimer in the
; documentation and/or other materials provided with the distribution.
; 
; 3. Neither the name of the copyright holder nor the names of its
; contributors may be used to endorse or promote products derived from this
; software without specific prior written permission.
; 
; Third party software included in this distribution is subject to the
; additional license terms as defined in the /docs/licenses directory.
; 
; THIS SOFTWARE IS PROVIDED BY THE COPYRIGHT HOLDERS AND CONTRIBUTORS "AS IS"
; AND ANY EXPRESS OR IMPLIED WARRANTIES, INCLUDING, BUT NOT LIMITED TO, THE
; IMPLIED WARRANTIES OF MERCHANTABILITY AND FITNESS FOR A PARTICULAR PURPOSE
; ARE DISCLAIMED. IN NO EVENT SHALL THE COPYRIGHT HOLDER OR CONTRIBUTORS BE
; LIABLE FOR ANY DIRECT, INDIRECT, INCIDENTAL, SPECIAL, EXEMPLARY, OR
; CONSEQUENTIAL DAMAGES (INCLUDING, BUT NOT LIMITED TO, PROCUREMENT OF
; SUBSTITUTE GOODS OR SERVICES; LOSS OF USE, DATA, OR PROFITS; OR BUSINESS
; INTERRUPTION) HOWEVER CAUSED AND ON ANY THEORY OF LIABILITY, WHETHER IN
; CONTRACT, STRICT LIABILITY, OR TORT (INCLUDING NEGLIGENCE OR OTHERWISE)
; ARISING IN ANY WAY OUT OF THE USE OF THIS SOFTWARE, EVEN IF ADVISED OF THE
; POSSIBILITY OF SUCH DAMAGE.
;
; This is part of revision 1.2.12 of the AmbiqSuite Development Package.
;
;******************************************************************************

;此文件次序基本和map中一致

;BLE core,ota
LR_1 0x0000C000
{
	;BLE_CORE_ROM_ADDR,BLE_CORE_ROM_LEN
	H002_BLE_CORE 0x0000C000 0x32000
    {
        startup_apollo.o 		(RESET, +First)
        startup_apollo.o 		(+RO)
        anon$$obj.o 			(+RO)
        __main.o 				(+RO)
		__dczerorl2.o 			(+RO)
		__scatter.o 			(+RO)
		__dczerorl.o 			(+RO)
		__scatter_copy.o 		(+RO)
		__scatter_zi.o 			(+RO)

		;stand lib
		__dclz77c.o				(+RO)
		entry.o 				(+RO)
		entry10a.o 				(+RO)
		entry11a.o 				(+RO)
		entry2.o 				(+RO)
		entry5.o 				(+RO)
		entry7b.o 				(+RO)
		entry8b.o 				(+RO)
		entry9a.o 				(+RO)
		handlers.o 				(+RO)
		init.o 					(+RO)
		llushr.o				(+RO)
		memcmp.o 				(+RO)
		memmovea.o 				(+RO)
		memseta.o 				(+RO)

		;set up
		sys_setup.o				(+RO)

        ;BLE lib
		att_main.o				(+RO)
		att_uuid.o				(+RO)
		attc_disc.o				(+RO)
		attc_main.o				(+RO)
		attc_proc.o				(+RO)
		attc_ccc.o				(+RO)
		attc_read.o				(+RO)
		attc_write.o			(+RO)
		atts_ccc.o				(+RO)
		atts_ind.o				(+RO)
		atts_main.o				(+RO)
		atts_proc.o				(+RO)
		atts_read.o				(+RO)
		atts_sign.o				(+RO)
		atts_write.o			(+RO)
		dm_adv.o				(+RO)
		dm_adv_leg.o			(+RO)
		dm_conn.o				(+RO)
		dm_conn_slave.o			(+RO)
		dm_conn_slave_leg.o		(+RO)
		dm_conn_sm.o			(+RO)
		dm_dev.o				(+RO)
		dm_main.o				(+RO)
		dm_priv.o				(+RO)
		dm_sec.o				(+RO)
		dm_sec_lesc.o			(+RO)
		dm_sec_master.o			(+RO)
		dm_sec_slave.o			(+RO)
		l2c_main.o				(+RO)
		l2c_slave.o				(+RO)
		smp_act.o				(+RO)
		smp_main.o				(+RO)
		smpr_sc_act.o			(+RO)
		smp_sc_main.o			(+RO)
		smpi_act.o				(+RO)
		smpi_sc_act.o			(+RO)
		smpi_sc_sm.o			(+RO)
		smpr_act.o				(+RO)
		smp_sc_act.o			(+RO)
		smpr_sc_sm.o			(+RO)
		smpr_sm.o				(+RO)

		;BLE
		app_db.o				(+RO)
		app_disc.o				(+RO)
		app_main.o				(+RO)
		app_server.o			(+RO)
		app_slave.o				(+RO)
		app_slave_leg.o			(+RO)
		hci_cmd.o				(+RO)
		hci_core.o				(+RO)
		hci_core_ps.o			(+RO)
		hci_evt.o				(+RO)
		hci_tr.o				(+RO)
		hci_vs.o				(+RO)
		sec_aes.o				(+RO)
		sec_cmac.o				(+RO)
		sec_ecc_hci.o			(+RO)
		sec_main.o				(+RO)
		svc_core.o				(+RO)
		svc_dis.o				(+RO)
		cfg_stack.o				(+RO)
		hci_main.o				(+RO)
		bda.o					(+RO)
		calc128.o				(+RO)
		crc32.o					(+RO)
		wstr.o					(+RO)
		wsf_assert.o			(+RO)
		wsf_math.o				(+RO)
		wsf_os.o				(+RO)
		wsf_trace.o				(+RO)
		wsf_buf.o				(+RO)
		wsf_efs.o				(+RO)
		wsf_msg.o				(+RO)
		wsf_queue.o				(+RO)
		wsf_timer.o				(+RO)
		gatt_main.o				(+RO)
		hci_drv_apollo3.o		(+RO)
		radio_task.o			(+RO)
		svc_lowsapp.o			(+RO)
		svc_amotas.o			(+RO)
		amotas_main.o			(+RO)
		lowsapp_main.o			(+RO)
		smota_flash.o 			(+RO)
		ble_comm.o				(+RO)
		ble_kernal.o			(+RO)
		amotas_main_v2.o		(+RO)
		ble_ota.o				(+RO)
		main_ota.o				(+RO)

		;FreeRTOS
		rtos.o 					(+RO)
		event_groups.o 			(+RO)
		list.o 					(+RO)
		queue.o 				(+RO)
		tasks.o 				(+RO)
		timers.o 				(+RO)
		heap_2.o 				(+RO)
		port.o 					(+RO)

		;MCU HAL
		am_hal_ble.o 			(+RO)
		am_hal_ble_patch.o 		(+RO)
		am_hal_burst.o 			(+RO)
		am_hal_cachectrl.o 		(+RO)
		am_hal_clkgen.o 		(+RO)
		am_hal_ctimer.o 		(+RO)
		am_hal_flash.o 			(+RO)
		am_hal_gpio.o 			(+RO)
		am_hal_interrupt.o 		(+RO)
		am_hal_mcuctrl.o 		(+RO)
		am_hal_pwrctrl.o 		(+RO)
		am_hal_queue.o 			(+RO)
		am_hal_reset.o 			(+RO)
		am_hal_rtc.o 			(+RO)
		am_hal_secure_ota.o 	(+RO)
		am_hal_stimer.o 		(+RO)
		am_hal_sysctrl.o 		(+RO)
		am_util_delay.o 		(+RO)
		am_util_faultisr.o 		(+RO)

		;SM
		sm_flash.o 				(+RO)
		sm_sys.o 				(+RO)
		sm_pwm.o 				(+RO)
		sm_os.o 				(+RO)


		;drv
		drv_nandflash_init.o	(+RO)
		drv_rgb_lcd.o			(+RO)
		
		;app
		system_task.o			(+RO)
		mid_lcd_core.o			(+RO)
		ui_ota_imagesrcource.o  (+RO)
		segger_rtt.o			(+RO)
		segger_rtt_printf.o		(+RO)
	}

    SRAM_BLE_CORE 0x10000000 0x2D000
    {
        startup_apollo.o 	(+RW, +ZI)
		sys_setup.o			(+RW, +ZI)

        ;BLE lib
		att_main.o			(+RW, +ZI)
		att_uuid.o			(+RW, +ZI)
		attc_disc.o			(+RW, +ZI)
		attc_main.o			(+RW, +ZI)
		attc_proc.o			(+RW, +ZI)
		attc_ccc.o			(+RW, +ZI)
		attc_read.o			(+RW, +ZI)
		attc_write.o		(+RW, +ZI)
		atts_ccc.o			(+RW, +ZI)
		atts_ind.o			(+RW, +ZI)
		atts_main.o			(+RW, +ZI)
		atts_proc.o			(+RW, +ZI)
		atts_read.o			(+RW, +ZI)
		atts_sign.o			(+RW, +ZI)
		atts_write.o		(+RW, +ZI)
		dm_adv.o			(+RW, +ZI)
		dm_adv_leg.o		(+RW, +ZI)
		dm_conn.o			(+RW, +ZI)
		dm_conn_slave.o		(+RW, +ZI)
		dm_conn_slave_leg.o	(+RW, +ZI)
		dm_conn_sm.o		(+RW, +ZI)
		dm_dev.o			(+RW, +ZI)
		dm_main.o			(+RW, +ZI)
		dm_priv.o			(+RW, +ZI)
		dm_sec.o			(+RW, +ZI)
		dm_sec_lesc.o		(+RW, +ZI)
		dm_sec_master.o		(+RW, +ZI)
		dm_sec_slave.o		(+RW, +ZI)
		l2c_main.o			(+RW, +ZI)
		l2c_slave.o			(+RW, +ZI)
		smp_act.o			(+RW, +ZI)
		smp_main.o			(+RW, +ZI)
		smpr_sc_act.o		(+RW, +ZI)
		smp_sc_main.o		(+RW, +ZI)
		smpi_act.o			(+RW, +ZI)
		smpi_sc_act.o		(+RW, +ZI)
		smpi_sc_sm.o		(+RW, +ZI)
		smpr_act.o			(+RW, +ZI)
		smp_sc_act.o		(+RW, +ZI)
		smpr_sc_sm.o		(+RW, +ZI)
		smpr_sm.o			(+RW, +ZI)

		;BLE
		app_db.o			(+RW, +ZI)
		app_disc.o			(+RW, +ZI)
		app_main.o			(+RW, +ZI)
		app_server.o		(+RW, +ZI)
		app_slave.o			(+RW, +ZI)
		app_slave_leg.o		(+RW, +ZI)
		hci_cmd.o			(+RW, +ZI)
		hci_core.o			(+RW, +ZI)
		hci_core_ps.o		(+RW, +ZI)
		hci_evt.o			(+RW, +ZI)
		hci_tr.o			(+RW, +ZI)
		hci_vs.o			(+RW, +ZI)
		sec_aes.o			(+RW, +ZI)
		sec_cmac.o			(+RW, +ZI)
		sec_ecc_hci.o		(+RW, +ZI)
		sec_main.o			(+RW, +ZI)
		svc_core.o			(+RW, +ZI)
		svc_dis.o			(+RW, +ZI)
		cfg_stack.o			(+RW, +ZI)
		hci_main.o			(+RW, +ZI)
		bda.o			    (+RW, +ZI)
		calc128.o			(+RW, +ZI)
		crc32.o				(+RW, +ZI)
		wstr.o				(+RW, +ZI)
		wsf_assert.o		(+RW, +ZI)
		wsf_math.o			(+RW, +ZI)
		wsf_os.o			(+RW, +ZI)
		wsf_trace.o			(+RW, +ZI)
		wsf_buf.o			(+RW, +ZI)
		wsf_efs.o			(+RW, +ZI)
		wsf_msg.o			(+RW, +ZI)
		wsf_queue.o			(+RW, +ZI)
		wsf_timer.o			(+RW, +ZI)
		gatt_main.o			(+RW, +ZI)
		hci_drv_apollo3.o	(+RW, +ZI)
		radio_task.o		(+RW, +ZI)
		svc_lowsapp.o		(+RW, +ZI)
		svc_amotas.o		(+RW, +ZI)
		amotas_main.o		(+RW, +ZI)
		lowsapp_main.o		(+RW, +ZI)
		smota_flash.o 		(+RW, +ZI)
		ble_comm.o			(+RW, +ZI)
		ble_kernal.o		(+RW, +ZI)
		amotas_main_v2.o	(+RW, +ZI)
		ble_ota.o			(+RW, +ZI)
		main_ota.o			(+RW, +ZI)

		;FreeRTOS
		rtos.o 				(+RW, +ZI)
		event_groups.o 		(+RW, +ZI)
		list.o 				(+RW, +ZI)
		queue.o 			(+RW, +ZI)
		tasks.o 			(+RW, +ZI)
		timers.o 			(+RW, +ZI)
		heap_2.o 			(+RW, +ZI)
		port.o 				(+RW, +ZI)

		;MCU HAL
		am_hal_ble.o 		(+RW, +ZI)
		am_hal_ble_patch.o 	(+RW, +ZI)
		am_hal_burst.o 		(+RW, +ZI)
		am_hal_cachectrl.o 	(+RW, +ZI)
		am_hal_clkgen.o 	(+RW, +ZI)
		am_hal_ctimer.o		(+RW, +ZI)
		am_hal_flash.o 		(+RW, +ZI)
		am_hal_gpio.o 		(+RW, +ZI)
		am_hal_interrupt.o 	(+RW, +ZI)
		am_hal_mcuctrl.o 	(+RW, +ZI)
		am_hal_pwrctrl.o 	(+RW, +ZI)
		am_hal_queue.o 		(+RW, +ZI)
		am_hal_reset.o 		(+RW, +ZI)
		am_hal_rtc.o 		(+RW, +ZI)
		am_hal_secure_ota.o	(+RW, +ZI)
		am_hal_stimer.o 	(+RW, +ZI)
		am_hal_sysctrl.o 	(+RW, +ZI)
		am_util_delay.o 	(+RW, +ZI)
		am_util_faultisr.o 	(+RW, +ZI)

		;SM
		sm_flash.o 			(+RW, +ZI)
		sm_sys.o 			(+RW, +ZI)
		sm_pwm.o 			(+RW, +ZI)
		sm_os.o 			(+RW, +ZI)

		;drv
		drv_nandflash_init.o (+RW, +ZI)
		drv_rgb_lcd.o		 (+RW, +ZI)

		;APP
		system_task.o		(+RW, +ZI)
		mid_lcd_core.o		(+RW, +ZI)
		segger_rtt.o		(+RW, +ZI)
		segger_rtt_printf.o	(+RW, +ZI)
	}
}

;APP and UI 
LR_2 0x0003E000
{
    ;APP_ROM_ADDR,   APP_ROM_LEN
	H002_APP 0x0003E000 0x64000
    {
        ;stand lib
		atan.o					(+RO)
		atan2.o					(+RO)
		atof.o 					(+RO)
		cos.o 					(+RO)
		cos_i.o 				(+RO)
		dunder.o              	(+RO)
		expf.o 					(+RO)
		fabs.o					(+RO)
		fpclassify.o			(+RO)
		fpclassifyf.o 			(+RO)
		funder.o 				(+RO)
		log.o					(+RO)
		log10f.o 				(+RO)
		logf.o					(+RO)
		poly.o					(+RO)
		pow.o					(+RO)
		powf.o					(+RO)
		qnan.o					(+RO)
		rred.o					(+RO)
		rredf.o					(+RO)
		rredf.o 				(+RO)
		sin_i.o 				(+RO)
		sinf.o					(+RO)
		sqrt.o					(+RO)
		sqrtf.o 				(+RO)
		_sgetc.o 	   			(+RO)
		ctype_c.o           	(+RO)
		errno.o 				(+RO)
		isspace_c.o 			(+RO)
		iusefp.o 				(+RO)
		llshl.o                 (+RO)
		llsshr.o 				(+RO)
		printfa.o 				(+RO)
		scanf_fp.o              (+RO)
		strlen.o				(+RO)
		strstr.o 				(+RO)
		strtod.o 				(+RO)
		uidiv.o 				(+RO)
		uldiv.o 				(+RO)
		cdcmple.o 				(+RO)
		cdrcmple.o 				(+RO)
		d2f.o                   (+RO)
		dadd.o 					(+RO)
		ddiv.o 					(+RO)
		depilogue.o 			(+RO)
		dfixi.o 				(+RO)
		dfixui.o 				(+RO)
		dfixul.o 				(+RO)
		dflti.o 				(+RO)
		dfltui.o 				(+RO)
		dfltul.o 				(+RO)
		dmul.o 					(+RO)
		dscalb.o 				(+RO)
		dsqrt.o 				(+RO)
		f2d.o 					(+RO)
		fepilogue.o 			(+RO)
		_printf_f.o				(+RO)
		atoi.o					(+RO)
		strtol.o				(+RO)
		ctype_o.o				(+RO)
		isspace_o.o				(+RO)
		_strtoul.o				(+RO)
		_chval.o				(+RO)
		fpstat.o				(+RO)

        ;心率lib
		Hr_motion8002.o				(+RO)
		api_set.o					(+RO)
		cal_hr.o					(+RO)
		check_motion_idx.o			(+RO)
		filter8002_fixed.o			(+RO)
		harmonic_grp_tracking.o		(+RO)
		math_op.o					(+RO)
		pah8002_api.o				(+RO)
		pah8series_hr.o				(+RO)
		peak_search.o				(+RO)
		signal_grade.o				(+RO)
		AdjustmentLPF.o				(+RO)
		FFT.o						(+RO)
		MedianFilter.o				(+RO)
		analysis.o					(+RO)
		anomaly.o					(+RO)
		br_iir.o					(+RO)
		hrv.o						(+RO)
		hrv_api.o					(+RO)
		oLPF_Fs100.o				(+RO)
		oLPF_Fs200.o				(+RO)
		pHPF.o						(+RO)
		pLPF.o						(+RO)
		xCorrelation.o				(+RO)
		xHampelFilter.o				(+RO)

		;字库 lib
		hfma2ylib.o					(+RO)

		;BLE
		ble_db.o					(+RO)
		ancc_main.o					(+RO)
		ancc_main_v2.o				(+RO)
		app_m_ble_profile.o			(+RO)
		ancs_main.o					(+RO)
		ancs_main_v2.o				(+RO)
		ble_task.o					(+RO)
		ancs_upload.o				(+RO)

		;MCU HAL
		am_hal_adc.o 				(+RO)
		am_hal_cmdq.o 				(+RO)
		am_hal_iom.o 				(+RO)
		am_hal_pdm.o 				(+RO)
		am_hal_uart.o 				(+RO)
		am_hal_wdt.o 				(+RO)
		am_hal_gpio_opt.o 			(+RO)
		am_hal_cachectrl_opt.o 		(+RO)
		am_hal_rtc_opt.o 			(+RO)
		am_hal_clkgen_opt.o 		(+RO)
		am_hal_mcuctrl_opt.o 		(+RO)
		am_hal_pwrctrl_opt.o 		(+RO)
		am_hal_reset_opt.o 			(+RO)
		am_hal_sysctrl_opt.o 		(+RO)
		am_util_delay_opt.o 		(+RO)

		;SM
		sm_adc.o 					(+RO)
		sm_gpio.o 					(+RO)
		sm_pdm.o 					(+RO)
		sm_spi.o 					(+RO)
		sm_swi2c.o 					(+RO)
		sm_hwi2c.o 					(+RO)
		sm_timer.o 					(+RO)
		sm_uart.o 					(+RO)
		sm_wdt.o 					(+RO)

		;DRV
		bsp_common.o				(+RO)
		drv_accelerate.o			(+RO)
		drv_airpress.o				(+RO)
		drv_bat.o					(+RO)
		drv_bm43.o					(+RO)
		drv_charger.o				(+RO)
		drv_common.o				(+RO)
		drv_font.o					(+RO)
		drv_gps.o					(+RO)
		drv_gyroscope.o				(+RO)
		drv_hrm.o					(+RO)
		drv_key.o					(+RO)
		drv_mag.o					(+RO)
		drv_mic.o					(+RO)
		drv_motor.o					(+RO)
		drv_mtimer.o				(+RO)
		drv_nandflash.o				(+RO)
		drv_ntc.o					(+RO)
		drv_touch.o					(+RO)
		bmi160.o					(+RO)

		;MID
		mid_accelerate.o			(+RO)
		mid_alarm.o					(+RO)
		mid_bat.o					(+RO)
		mid_common.o				(+RO)
		mid_countdown.o				(+RO)
		mid_front.o					(+RO)
		mid_gyroscope.o				(+RO)
		mid_heartrate_scene.o		(+RO)
		mid_hrm.o					(+RO)
		mid_infrared_temp.o			(+RO)
		mid_key.o					(+RO)
		mid_lcd.o					(+RO)
		mid_magnetism.o				(+RO)
		mid_mic.o					(+RO)
		mid_motor.o					(+RO)
		mid_nandflash.o				(+RO)
		mid_pressure.o				(+RO)
		mid_rtc.o					(+RO)
		mid_scheduler.o				(+RO)
		mid_stopwatch.o				(+RO)
		mid_uart.o					(+RO)
		mid_weather_scene.o			(+RO)
		mid_wdt.o					(+RO)
		mid_6dof.o					(+RO)

		;algorithm 
		algorithm_abc.o				(+RO)
        algorithm_climbmountain.o	(+RO)
        algorithm_common.o			(+RO)
        algorithm_gesture.o			(+RO)
		algorithm_lis3dh.o			(+RO)
        algorithm_running.o			(+RO)
        algorithm_sedentary.o		(+RO)
        algorithm_sleep.o			(+RO)
        algorithm_stress.o			(+RO)
        algorithm_swimindoor.o		(+RO)
        algorithm_usual.o			(+RO)
        algorithm_swim_indoor.o		(+RO)
        algorithm_climb_stairs.o	(+RO)

        ;scene
        scene_abc.o					(+RO)
		scene_climb.o				(+RO)
		scene_common.o				(+RO)
		scene_findphone.o			(+RO)
		scene_gesture.o				(+RO)
		scene_hrm.o					(+RO)
		scene_interface.o			(+RO)
		scene_run.o					(+RO)
        scene_sedentary.o			(+RO)
        scene_sleep.o				(+RO)
        scene_step.o				(+RO)
		scene_stress.o				(+RO)
		scene_swim.o				(+RO)
		scene_task.o				(+RO)
		scene_stairs.o				(+RO)
		scene_weather.o				(+RO)
		scene_alarm.o				(+RO)
		scene_stopwatch.o			(+RO)
		scene_countdown.o			(+RO)

        mod_algorithm.o				(+RO)
		mod_power.o					(+RO)
		mod_time.o					(+RO)
		mod_system.o				(+RO)
		store_algo.o				(+RO)
		store_variable.o			(+RO)
		store_interface.o			(+RO)
		store_inner.o				(+RO)
		store_common.o				(+RO)
		store_step.o				(+RO)
		store_hrd.o					(+RO)
		store_part.o				(+RO)
		store_pdu.o					(+RO)
		store_upload.o				(+RO)
		store_task.o				(+RO)
		store_run.o					(+RO)
		store_stress.o				(+RO)
		store_bodytemp.o			(+RO)
		store_sleep.o				(+RO)
		store_climb.o				(+RO)
		store_swim.o				(+RO)
		store_abc.o					(+RO)
		store_sleep_record.o		(+RO)
		store_history.o				(+RO)

		;APP
		main.o						(+RO)
		app_task.o					(+RO)
		app_protocal.o				(+RO)
		app_rtc.o					(+RO)
		app_variable.o				(+RO)
		app_lcd.o					(+RO)
		app_remind_manage.o         (+RO)
		system_clock.o				(+RO)
		app_systerm.o				(+RO)
		app_time.o					(+RO)

        ;other drv
		pah_hrd_function.o			(+RO)
		pah_8011_internal.o			(+RO)
		pah_comm_i2c.o				(+RO)
		pah_driver_8011.o			(+RO)
		pah_driver_8011_reg_array.o	(+RO)
		pah_hrv_function.o			(+RO)

		;UI
		ui_display_common.o			(+RO)
		ui_display_main.o			(+RO)
		ui_keyhandle_main.o			(+RO)
		ui_screen_alarm.o			(+RO)
		ui_screen_breathtraining.o	(+RO)
		ui_screen_climbing.o		(+RO)
		ui_screen_compass.o			(+RO)
		ui_screen_countdown.o		(+RO)
		ui_screen_dateandtime.o		(+RO)
		ui_screen_findphone.o		(+RO)
		ui_screen_heartrate.o		(+RO)
		ui_screen_history.o			(+RO)
		ui_screen_modelist.o		(+RO)
		ui_screen_other.o			(+RO)
		ui_display_poweron.o     	(+RO)
		ui_screen_pressure.o		(+RO)
		ui_screen_runingmode.o		(+RO)
		ui_screen_setting.o			(+RO)
		ui_screen_sleep.o			(+RO)
		ui_screen_sporthistory.o	(+RO)
		ui_screen_step.o			(+RO)
		ui_screen_stopwatch.o		(+RO)
		ui_screen_store.o			(+RO)
		ui_screen_swim.o			(+RO)
		ui_screen_temperature.o		(+RO)
		ui_screen_warn.o			(+RO)
		ui_timerhandle_main.o		(+RO)
		ui_tphandle_main.o			(+RO)
		win_main.o					(+RO)
		win_timer.o					(+RO)
		win_task.o					(+RO)
		win_store.o					(+RO)
		win_pwron.o					(+RO)
		win_datetime.o				(+RO)
		win_step.o					(+RO)
		win_heartrate.o				(+RO)
		win_stress.o				(+RO)
		win_temperature.o			(+RO)
		win_sleep.o					(+RO)
		win_abc.o					(+RO)
		win_history.o				(+RO)
		win_lock.o					(+RO)
		win_modelist.o				(+RO)
		win_run.o					(+RO)
		win_climb.o					(+RO)
		win_swim.o					(+RO)
		win_sporthistory.o			(+RO)
		win_stopwatch.o				(+RO)
		win_countdown.o				(+RO)
		win_alarm.o					(+RO)
		win_findphone.o				(+RO)
		win_set.o					(+RO)
		win_charge.o				(+RO)
		win_warn.o					(+RO)
    }

    SRAM_APP 0x1002D000 0x32000
    {
        ;stand lib
        errno.o						(+RW, +ZI)

        ;心率lib
		Hr_motion8002.o				(+RW, +ZI)
		api_set.o					(+RW, +ZI)
		cal_hr.o					(+RW, +ZI)
		check_motion_idx.o			(+RW, +ZI)
		filter8002_fixed.o			(+RW, +ZI)
		harmonic_grp_tracking.o		(+RW, +ZI)
		math_op.o					(+RW, +ZI)
		pah8002_api.o				(+RW, +ZI)
		pah8series_hr.o				(+RW, +ZI)
		peak_search.o				(+RW, +ZI)
		signal_grade.o				(+RW, +ZI)
		AdjustmentLPF.o				(+RW, +ZI)
		FFT.o						(+RW, +ZI)
		MedianFilter.o				(+RW, +ZI)
		analysis.o					(+RW, +ZI)
		anomaly.o					(+RW, +ZI)
		br_iir.o					(+RW, +ZI)
		hrv.o						(+RW, +ZI)
		hrv_api.o					(+RW, +ZI)
		oLPF_Fs100.o				(+RW, +ZI)
		oLPF_Fs200.o				(+RW, +ZI)
		pHPF.o						(+RW, +ZI)
		pLPF.o						(+RW, +ZI)
		xCorrelation.o				(+RW, +ZI)
		xHampelFilter.o				(+RW, +ZI)

		;字库 lib
		hfma2ylib.o					(+RW, +ZI)

		;BLE
		ble_db.o					(+RW, +ZI)
		ancc_main.o					(+RW, +ZI)
		ancc_main_v2.o				(+RW, +ZI)
		app_m_ble_profile.o			(+RW, +ZI)
		ancs_main.o					(+RW, +ZI)
		ancs_main_v2.o				(+RW, +ZI)
		ble_task.o					(+RW, +ZI)
		ancs_upload.o				(+RW, +ZI)

		;MCU HAL
		am_hal_adc.o 				(+RW, +ZI)
		am_hal_cmdq.o 				(+RW, +ZI)
		am_hal_iom.o 				(+RW, +ZI)
		am_hal_pdm.o 				(+RW, +ZI)
		am_hal_uart.o 				(+RW, +ZI)
		am_hal_wdt.o 				(+RW, +ZI)		
		am_hal_cachectrl_opt.o 		(+RW, +ZI)
		am_hal_rtc_opt.o 			(+RW, +ZI)
		am_hal_clkgen_opt.o 		(+RW, +ZI)
		am_hal_gpio_opt.o 			(+RW, +ZI)
		am_hal_mcuctrl_opt.o 		(+RW, +ZI)
		am_hal_pwrctrl_opt.o 		(+RW, +ZI)
		am_hal_reset_opt.o 			(+RW, +ZI)
		am_hal_sysctrl_opt.o 		(+RW, +ZI)
		am_util_delay_opt.o 		(+RW, +ZI)

		;SM
		sm_adc.o 					(+RW, +ZI)
		sm_gpio.o 					(+RW, +ZI)
		sm_pdm.o 					(+RW, +ZI)
		sm_spi.o 					(+RW, +ZI)
		sm_swi2c.o 					(+RW, +ZI)
		sm_hwi2c.o 					(+RW, +ZI)
		sm_timer.o 					(+RW, +ZI)
		sm_uart.o 					(+RW, +ZI)
		sm_wdt.o 					(+RW, +ZI)

		;DRV
		bsp_common.o				(+RW, +ZI)
		drv_accelerate.o			(+RW, +ZI)
		drv_airpress.o				(+RW, +ZI)
		drv_bat.o					(+RW, +ZI)
		drv_bm43.o					(+RW, +ZI)
		drv_charger.o				(+RW, +ZI)
		drv_common.o				(+RW, +ZI)
		drv_font.o					(+RW, +ZI)
		drv_gps.o					(+RW, +ZI)
		drv_gyroscope.o				(+RW, +ZI)
		drv_hrm.o					(+RW, +ZI)
		drv_key.o					(+RW, +ZI)
		drv_mag.o					(+RW, +ZI)
		drv_mic.o					(+RW, +ZI)
		drv_motor.o					(+RW, +ZI)
		drv_mtimer.o				(+RW, +ZI)
		drv_nandflash.o				(+RW, +ZI)
		drv_ntc.o					(+RW, +ZI)
		drv_touch.o					(+RW, +ZI)
		bmi160.o					(+RW, +ZI)

		;MID
		mid_accelerate.o			(+RW, +ZI)
		mid_alarm.o					(+RW, +ZI)
		mid_bat.o					(+RW, +ZI)
		mid_common.o				(+RW, +ZI)
		mid_countdown.o				(+RW, +ZI)
		mid_front.o					(+RW, +ZI)
		mid_gyroscope.o				(+RW, +ZI)
		mid_heartrate_scene.o		(+RW, +ZI)
		mid_hrm.o					(+RW, +ZI)
		mid_infrared_temp.o			(+RW, +ZI)
		mid_key.o					(+RW, +ZI)
		mid_lcd.o					(+RW, +ZI)
		mid_magnetism.o				(+RW, +ZI)
		mid_mic.o					(+RW, +ZI)
		mid_motor.o					(+RW, +ZI)
		mid_nandflash.o				(+RW, +ZI)
		mid_pressure.o				(+RW, +ZI)
		mid_rtc.o					(+RW, +ZI)
		mid_scheduler.o				(+RW, +ZI)
		mid_stopwatch.o				(+RW, +ZI)
		mid_uart.o					(+RW, +ZI)
		mid_weather_scene.o			(+RW, +ZI)
		mid_wdt.o					(+RW, +ZI)
		mid_6dof.o					(+RW, +ZI)

		;algorithm 
		algorithm_abc.o				(+RW, +ZI)
        algorithm_climbmountain.o	(+RW, +ZI)
        algorithm_common.o			(+RW, +ZI)
        algorithm_gesture.o			(+RW, +ZI)
		algorithm_lis3dh.o			(+RW, +ZI)
        algorithm_running.o			(+RW, +ZI)
        algorithm_sedentary.o		(+RW, +ZI)
        algorithm_sleep.o			(+RW, +ZI)
        algorithm_stress.o			(+RW, +ZI)
        algorithm_swimindoor.o		(+RW, +ZI)
        algorithm_usual.o			(+RW, +ZI)
        algorithm_swim_indoor.o		(+RW, +ZI)
        algorithm_climb_stairs.o	(+RW, +ZI)

        ;scene
        scene_abc.o					(+RW, +ZI)
		scene_climb.o				(+RW, +ZI)
		scene_common.o				(+RW, +ZI)
		scene_findphone.o			(+RW, +ZI)
		scene_gesture.o				(+RW, +ZI)
		scene_hrm.o					(+RW, +ZI)
		scene_interface.o			(+RW, +ZI)
		scene_run.o					(+RW, +ZI)
        scene_sedentary.o			(+RW, +ZI)
        scene_sleep.o				(+RW, +ZI)
        scene_step.o				(+RW, +ZI)
		scene_stress.o				(+RW, +ZI)
		scene_swim.o				(+RW, +ZI)
		scene_task.o				(+RW, +ZI)
		scene_stairs.o				(+RW, +ZI)
		scene_weather.o				(+RW, +ZI)
		scene_alarm.o				(+RW, +ZI)
		scene_stopwatch.o			(+RW, +ZI)
		scene_countdown.o			(+RW, +ZI)

		mod_algorithm.o				(+RW, +ZI)
		mod_power.o					(+RW, +ZI)
		mod_time.o					(+RW, +ZI)
		mod_system.o				(+RW, +ZI)
		store_algo.o				(+RW, +ZI)
		store_variable.o			(+RW, +ZI)
		store_interface.o			(+RW, +ZI)
		store_inner.o				(+RW, +ZI)
		store_common.o				(+RW, +ZI)
		store_step.o				(+RW, +ZI)
		store_hrd.o					(+RW, +ZI)
		store_part.o				(+RW, +ZI)
		store_pdu.o					(+RW, +ZI)
		store_upload.o				(+RW, +ZI)
		store_task.o				(+RW, +ZI)
		store_run.o					(+RW, +ZI)
		store_stress.o				(+RW, +ZI)
		store_bodytemp.o			(+RW, +ZI)
		store_sleep.o				(+RW, +ZI)
		store_climb.o				(+RW, +ZI)
		store_swim.o				(+RW, +ZI)
		store_abc.o					(+RW, +ZI)
		store_sleep_record.o		(+RW, +ZI)
		store_history.o				(+RW, +ZI)

		;APP
		main.o						(+RW, +ZI)
		app_task.o					(+RW, +ZI)
		app_protocal.o				(+RW, +ZI)
		app_rtc.o					(+RW, +ZI)
		app_variable.o				(+RW, +ZI)
		app_lcd.o					(+RW, +ZI)
		app_remind_manage.o			(+RW, +ZI)
		system_clock.o				(+RW, +ZI)
		app_systerm.o				(+RW, +ZI)
		app_time.o					(+RW, +ZI)

        ;other drv
		pah_hrd_function.o			(+RW, +ZI)
		pah_8011_internal.o			(+RW, +ZI)
		pah_comm_i2c.o				(+RW, +ZI)
		pah_driver_8011.o			(+RW, +ZI)
		pah_driver_8011_reg_array.o	(+RW, +ZI)
		pah_hrv_function.o			(+RW, +ZI)

		;UI
		ui_display_common.o			(+RW, +ZI)
		ui_display_main.o			(+RW, +ZI)
		ui_keyhandle_main.o			(+RW, +ZI)
		ui_screen_alarm.o			(+RW, +ZI)
		ui_screen_breathtraining.o	(+RW, +ZI)
		ui_screen_climbing.o		(+RW, +ZI)
		ui_screen_compass.o			(+RW, +ZI)
		ui_screen_countdown.o		(+RW, +ZI)
		ui_screen_dateandtime.o		(+RW, +ZI)
		ui_screen_findphone.o		(+RW, +ZI)
		ui_screen_heartrate.o		(+RW, +ZI)
		ui_screen_history.o			(+RW, +ZI)
		ui_screen_modelist.o		(+RW, +ZI)
		ui_screen_other.o			(+RW, +ZI)
		ui_display_poweron.o     	(+RW, +ZI)
		ui_screen_pressure.o		(+RW, +ZI)
		ui_screen_runingmode.o		(+RW, +ZI)
		ui_screen_setting.o			(+RW, +ZI)
		ui_screen_sleep.o			(+RW, +ZI)
		ui_screen_sporthistory.o	(+RW, +ZI)
		ui_screen_step.o			(+RW, +ZI)
		ui_screen_stopwatch.o		(+RW, +ZI)
		ui_screen_store.o			(+RW, +ZI)
		ui_screen_swim.o			(+RW, +ZI)
		ui_screen_temperature.o		(+RW, +ZI)
		ui_screen_warn.o			(+RW, +ZI)
		ui_timerhandle_main.o		(+RW, +ZI)
		ui_tphandle_main.o			(+RW, +ZI)
		win_main.o					(+RW, +ZI)
		win_timer.o					(+RW, +ZI)
		win_task.o					(+RW, +ZI)
		win_store.o					(+RW, +ZI)
		win_pwron.o					(+RW, +ZI)
		win_datetime.o				(+RW, +ZI)
		win_step.o					(+RW, +ZI)
		win_heartrate.o				(+RW, +ZI)
		win_stress.o				(+RW, +ZI)
		win_temperature.o			(+RW, +ZI)
		win_sleep.o					(+RW, +ZI)
		win_abc.o					(+RW, +ZI)
		win_history.o				(+RW, +ZI)
		win_lock.o					(+RW, +ZI)
		win_modelist.o				(+RW, +ZI)
		win_run.o					(+RW, +ZI)
		win_climb.o					(+RW, +ZI)
		win_swim.o					(+RW, +ZI)
		win_sporthistory.o			(+RW, +ZI)
		win_stopwatch.o				(+RW, +ZI)
		win_countdown.o				(+RW, +ZI)
		win_alarm.o					(+RW, +ZI)
		win_findphone.o				(+RW, +ZI)
		win_set.o					(+RW, +ZI)
		win_charge.o				(+RW, +ZI)
		win_warn.o					(+RW, +ZI)
    }
}


;以下是固定不变的数据，不要在此区域加减东西
LR_3 0xA6000
{
    ;UI_ROM_ADDR,  UI_ROM_LEN
	H002_UI_IMAGE 0xA6000 0x1A000
	{
		app_ascii_source.o			(+RO)
		ui_display_fontsource.o		(+RO)
		ui_display_imagesource.o	(+RO)
	}
}

